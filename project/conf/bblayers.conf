## project/conf/bblayers.conf
```bitbake
# POKY_BBLAYERS_CONF_VERSION is increased each time build/conf/bblayers.conf
# changes incompatibly
POKY_BBLAYERS_CONF_VERSION = "2"

BBPATH = "${TOPDIR}"
BBFILES ?= ""

BBLAYERS ?= " \
  ${TOPDIR}/../layers/openembedded-core/meta \
  ${TOPDIR}/../layers/openembedded-core/../meta-yocto/meta-poky \
  ${TOPDIR}/../layers/openembedded-core/../meta-yocto/meta-yocto-bsp \
  ${TOPDIR}/../layers/meta-openembedded/meta-oe \
  ${TOPDIR}/../layers/meta-openembedded/meta-python \
  ${TOPDIR}/../layers/meta-openembedded/meta-networking \
  ${TOPDIR}/../layers/meta-openembedded/meta-filesystems \
  ${TOPDIR}/../layers/meta-openembedded/meta-webserver \
  ${TOPDIR}/../layers/meta-clang \
  ${TOPDIR}/../layers/meta-virtualization \
  ${TOPDIR}/../layers/meta-qa/meta-qa-framework \
  ${TOPDIR}/../layers/meta-qa/meta-qa-testsuites \
  ${TOPDIR}/../layers/meta-montavista-cgx \
  ${TOPDIR}/../layers/meta-openembedded/meta-perl \
  ${TOPDIR}/../layers/meta-openembedded/meta-gnome \
  ${TOPDIR}/../layers/meta-openembedded/meta-multimedia \
  ${TOPDIR}/../layers/meta-openembedded/meta-xfce \
  ${TOPDIR}/../layers/meta-selinux \
  ${TOPDIR}/../layers/meta-security \
  ${TOPDIR}/../layers/meta-arm/meta-arm-toolchain \
  ${TOPDIR}/../layers/meta-arm/meta-arm \
  ${TOPDIR}/../layers/meta-cgl/meta-cgl-common \
  ${TOPDIR}/../layers/meta-cloud-services \
  ${TOPDIR}/../layers/meta-montavista-cgl \
  ${TOPDIR}/../layers/meta-montavista-armsr \
  "
```
